## samples/empty/zephyr/boards/stm32h747i_disco_stm32h747xx_m7.conf
```kconfig
CONFIG_POSIX_API=y
CONFIG_POSIX_DEVICE_IO=y
CONFIG_POSIX_FD_MGMT=y
CONFIG_ZVFS_OPEN_MAX=16
CONFIG_FILE_SYSTEM_EXT2=y
CONFIG_DISK_ACCESS=y
CONFIG_MEMC=y
CONFIG_STM32_LTDC_RGB565=y
CONFIG_DISPLAY_LOG_LEVEL_WRN=y
CONFIG_DISPLAY_NT35510_INIT_PRIORITY=87
```

## samples/empty/zephyr/manifest/west.yml
```yaml
manifest:
  remotes:
    - name: zephyrproject-rtos
      url-base: https://github.com/zephyrproject-rtos
    - name: antmicro
      url-base: https://github.com/antmicro
  projects:
    - name: zephyr
      remote: zephyrproject-rtos
      revision: 3a6406439c5a7c55e932df21df4aa290e0fb7751
      import:
        name-allowlist:
          - cmsis_6
          - hal_stm32
    - name: grvl
      path: modules/grvl
      url: https://github.com/antmicro/grvl.git
      revision: HEAD~0
```
